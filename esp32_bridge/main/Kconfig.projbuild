## esp32_bridge/main/Kconfig.projbuild
```kconfig
menu "Scope bridge"

config BRIDGE_WIFI_SSID
    string "WiFi SSID"
    default "myssid"

config BRIDGE_WIFI_PASSWORD
    string "WiFi password"
    default "mypassword"

config BRIDGE_TCP_PORT
    int "TCP port for the transparent CDC bridge"
    default 7001

config BRIDGE_USB_VID
    hex "USB VID to open (0 = any CDC-ACM device)"
    default 0

config BRIDGE_USB_PID
    hex "USB PID to open (0 = any)"
    default 0

endmenu
```

## esp32_bridge/sdkconfig.defaults
```kconfig
CONFIG_IDF_TARGET="esp32s3"
CONFIG_ESPTOOLPY_FLASHSIZE_16MB=y
CONFIG_PARTITION_TABLE_SINGLE_APP_LARGE=y
CONFIG_USB_HOST_CONTROL_TRANSFER_MAX_SIZE=1024
CONFIG_LWIP_SO_REUSE=y
CONFIG_ESP_WIFI_STA_DISCONNECTED_PM_ENABLE=n
CONFIG_PM_ENABLE=n
```
